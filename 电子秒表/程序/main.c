/***************************************************************************
****************************			       *****************************
***************************		 电子秒表	    ****************************
****************************				   *****************************
***************************************************************************/

/***************************************************************************
*
*简介：基于51单片机lcd1602和矩阵按键的电子秒表，可显示最大99.59.99分钟，可自
*	   定义记录N组最大9组时间，采用定时器0对矩阵按键消抖，不再用往常的延时消
*	   抖，从而减少了显示的时间的误差。显示误差大概为每100分钟慢7秒。
*	   对矩阵按键排序，第一行为1，2，3，4，第二行5，6...以此类推，下面是定义
*      的按键的功能：9-开始与暂停，10-记录时间，11-清零，13-菜单（页码）加一
*      14-菜单减一，15-向后翻阅时间，16-向前翻阅时间记录。
***************************************************************************/
#include "lcd1602.h"
#include "Interrupt.h"
#include "function.h"
#include "Key.h"

void main()
{
	Timer0_Init();
	Timer1_Init();//定时器初始化
	lcd1602_Init();//lcd初始化
	Init_face();//进入时画面
	major_face();//画面过后显示主页面
	Time_face(2, 5, ssec, sec, min);//同上
	while(1)
	{
		Key_scan();//按键检查
		Key_fun();//按键功能
		if(TR1==1)
		{
			Time_face(2, 5, ssec, sec, min);//更新计时时间
		}
	}
}

void Timer0() interrupt 1
{
	TL0 = 0x00;
	TH0 = 0xCA;
	TR0=0;
	Key();
}

void Timer1() interrupt 3
{
	TL1 = 0x00;
	TH1 = 0xDC;
	ssec++;
	if(ssec==100)
	{
		ssec=0;
		sec++;
		if(sec==60)
		{
			sec=0;
			min++;
			if(min==100)
			{
				min=0;
			}
		}
	}
}